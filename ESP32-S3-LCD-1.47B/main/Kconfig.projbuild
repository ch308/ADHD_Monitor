## ESP32-S3-LCD-1.47B/main/Kconfig.projbuild
```kconfig
menu "Example Configuration"
    config LV_MEM_SIZE_KILOBYTES
        int "Size of the memory used by `lv_mem_alloc` in kilobytes (>= 2kB)"
        default 48
            
    config LV_USE_DEMO_WIDGETS
        bool "Show some widget"
        default y
        
    config LV_DEMO_WIDGETS_SLIDESHOW
        bool "Enable slide show"
        depends on LV_USE_DEMO_WIDGETS
        default y

    config LV_USE_DEMO_KEYPAD_AND_ENCODER
        bool "Demonstrate the usage of encoder and keyboard"
        default y

    config LV_USE_DEMO_BENCHMARK
        bool "Benchmark your system"
        default y

    config LV_USE_DEMO_STRESS
        bool "Stress test for LVGL"
        default y

    config LV_USE_DEMO_MUSIC
        bool "Music player demo"
        default y

    
    config LV_FONT_MONTSERRAT_12
        bool "Enable Montserrat 12"
        default y if !LV_CONF_MINIMAL

    config LV_FONT_MONTSERRAT_14
        bool "Enable Montserrat 14"
        default y if !LV_CONF_MINIMAL

    config LV_FONT_MONTSERRAT_16
        bool "Enable Montserrat 16"
        default y if !LV_CONF_MINIMAL
        


    config BT_ENABLED
        bool "Select this option to enable Bluetooth"
        default y 

    config BT_BLE_50_FEATURES_SUPPORTED
        bool "Enabling this option activates BLE 5.0 features"
        default y 
        
    config BT_BLE_42_FEATURES_SUPPORTED
        bool "This enables BLE 4.2 features."
        default y 

    # 旧 Kconfig 项保留兼容（已不再被代码读取），运行时凭据走 BLE provisioning + NVS
    config EXAMPLE_WIFI_SSID
        string "(legacy) WiFi SSID — 已弃用，由 BLE 配网填写"
        default ""

    config EXAMPLE_WIFI_PASSWORD
        string "(legacy) WiFi password — 已弃用，由 BLE 配网填写"
        default ""

    menu "ADHD Cloud (server long-poll)"
        config ADHD_CLOUD_HOST
            string "Cloud server host (IP / DNS)"
            default "124.223.53.33"
            help
                ESP32 长轮询的服务器地址。和 Flutter 端 SessionStore 默认主机保持一致。

        config ADHD_CLOUD_PORT
            int "Cloud server port"
            default 11760

        config ADHD_CLOUD_POLL_WAIT_S
            int "Long-poll hold time (s)"
            default 25
            range 1 60
            help
                ESP32 一次拉指令时让服务器最多 hold 多久（秒）。
    endmenu

endmenu
```
